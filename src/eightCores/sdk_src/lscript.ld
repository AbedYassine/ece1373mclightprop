/*******************************************************************/
/*                                                                 */
/* This file is automatically generated by linker script generator.*/
/*                                                                 */
/* Version:                                 */
/*                                                                 */
/* Copyright (c) 2010-2016 Xilinx, Inc.  All rights reserved.      */
/*                                                                 */
/* Description : MicroBlaze Linker Script                          */
/*                                                                 */
/*******************************************************************/

_STACK_SIZE = DEFINED(_STACK_SIZE) ? _STACK_SIZE : 0x400;
_HEAP_SIZE = DEFINED(_HEAP_SIZE) ? _HEAP_SIZE : 0x800;

/* Define Memories in the system */

MEMORY
{
   microblaze_0_local_memory_ilmb_bram_if_cntlr_Mem_microblaze_0_local_memory_dlmb_bram_if_cntlr_Mem : ORIGIN = 0x50, LENGTH = 0x3FFB0
   absorption0_Mem0 : ORIGIN = 0x20000000, LENGTH = 0x2000
   absorption1_Mem0 : ORIGIN = 0x20002000, LENGTH = 0x2000
   absorption2_Mem0 : ORIGIN = 0x20004000, LENGTH = 0x2000
   absorption3_Mem0 : ORIGIN = 0x20006000, LENGTH = 0x2000
   absorption4_Mem0 : ORIGIN = 0x20008000, LENGTH = 0x2000
   absorption5_Mem0 : ORIGIN = 0x2000A000, LENGTH = 0x2000
   absorption6_Mem0 : ORIGIN = 0x2000C000, LENGTH = 0x2000
   absorption7_Mem0 : ORIGIN = 0x2000E000, LENGTH = 0x2000
   absorption8_Mem0 : ORIGIN = 0x20010000, LENGTH = 0x2000
   absorption9_Mem0 : ORIGIN = 0x20030000, LENGTH = 0x2000
   absorption10_Mem0 : ORIGIN = 0x20050000, LENGTH = 0x2000
   absorption11_Mem0 : ORIGIN = 0x20060000, LENGTH = 0x2000
   absorption12_Mem0 : ORIGIN = 0x20070000, LENGTH = 0x2000
   absorption13_Mem0 : ORIGIN = 0x20080000, LENGTH = 0x2000
   absorption14_Mem0 : ORIGIN = 0x20090000, LENGTH = 0x2000
   absorption15_Mem0 : ORIGIN = 0x200A0000, LENGTH = 0x2000
   absorption16_Mem0 : ORIGIN = 0x20100000, LENGTH = 0x2000
   absorption17_Mem0 : ORIGIN = 0x20120000, LENGTH = 0x2000
   absorption18_Mem0 : ORIGIN = 0x20140000, LENGTH = 0x2000
   absorption19_Mem0 : ORIGIN = 0x20160000, LENGTH = 0x2000
   absorption20_Mem0 : ORIGIN = 0x20180000, LENGTH = 0x2000
   absorption21_Mem0 : ORIGIN = 0x201A0000, LENGTH = 0x2000
   absorption22_Mem0 : ORIGIN = 0x201C0000, LENGTH = 0x2000
   absorption23_Mem0 : ORIGIN = 0x201D0000, LENGTH = 0x2000
   absorption24_Mem0 : ORIGIN = 0x201E0000, LENGTH = 0x2000
   absorption25_Mem0 : ORIGIN = 0x201F0000, LENGTH = 0x2000
   absorption26_Mem0 : ORIGIN = 0x20200000, LENGTH = 0x2000
   absorption27_Mem0 : ORIGIN = 0x20210000, LENGTH = 0x2000
   absorption28_Mem0 : ORIGIN = 0x20220000, LENGTH = 0x2000
   absorption29_Mem0 : ORIGIN = 0x20230000, LENGTH = 0x2000
   absorption30_Mem0 : ORIGIN = 0x20240000, LENGTH = 0x2000
   absorption31_Mem0 : ORIGIN = 0x20250000, LENGTH = 0x2000
   material_idx0_Mem0 : ORIGIN = 0x30000000, LENGTH = 0x2000
   material_idx1_Mem0 : ORIGIN = 0x30010000, LENGTH = 0x2000
   material_idx2_Mem0 : ORIGIN = 0x30020000, LENGTH = 0x2000
   material_idx3_Mem0 : ORIGIN = 0x30030000, LENGTH = 0x2000
   material_idx4_Mem0 : ORIGIN = 0x30040000, LENGTH = 0x2000
   material_idx5_Mem0 : ORIGIN = 0x30050000, LENGTH = 0x2000
   material_idx6_Mem0 : ORIGIN = 0x30060000, LENGTH = 0x2000
   material_idx7_Mem0 : ORIGIN = 0x30070000, LENGTH = 0x2000
   material_idx8_Mem0 : ORIGIN = 0x30080000, LENGTH = 0x2000
   material_idx9_Mem0 : ORIGIN = 0x30090000, LENGTH = 0x2000
   material_idx10_Mem0 : ORIGIN = 0x300A0000, LENGTH = 0x2000
   material_idx11_Mem0 : ORIGIN = 0x300B0000, LENGTH = 0x2000
   material_idx12_Mem0 : ORIGIN = 0x300C0000, LENGTH = 0x2000
   material_idx13_Mem0 : ORIGIN = 0x300D0000, LENGTH = 0x2000
   material_idx14_Mem0 : ORIGIN = 0x300E0000, LENGTH = 0x2000
   material_idx15_Mem0 : ORIGIN = 0x300F0000, LENGTH = 0x2000
   materials_array0_Mem0 : ORIGIN = 0x30100000, LENGTH = 0x2000
   materials_array1_Mem0 : ORIGIN = 0x30110000, LENGTH = 0x2000
   materials_array2_Mem0 : ORIGIN = 0x30120000, LENGTH = 0x2000
   materials_array3_Mem0 : ORIGIN = 0x30130000, LENGTH = 0x2000
   materials_array4_Mem0 : ORIGIN = 0x30140000, LENGTH = 0x2000
   materials_array5_Mem0 : ORIGIN = 0x30150000, LENGTH = 0x2000
   materials_array6_Mem0 : ORIGIN = 0x30160000, LENGTH = 0x2000
   materials_array7_Mem0 : ORIGIN = 0x30170000, LENGTH = 0x2000
   materials_array8_Mem0 : ORIGIN = 0x30180000, LENGTH = 0x2000
   materials_array9_Mem0 : ORIGIN = 0x30190000, LENGTH = 0x2000
   materials_array10_Mem0 : ORIGIN = 0x301A0000, LENGTH = 0x2000
   materials_array11_Mem0 : ORIGIN = 0x301B0000, LENGTH = 0x2000
   materials_array12_Mem0 : ORIGIN = 0x38000000, LENGTH = 0x2000
   materials_array13_Mem0 : ORIGIN = 0x3A000000, LENGTH = 0x2000
   materials_array14_Mem0 : ORIGIN = 0x3C000000, LENGTH = 0x2000
   materials_array15_Mem0 : ORIGIN = 0x3E000000, LENGTH = 0x2000
}

/* Specify the default entry point to the program */

ENTRY(_start)

/* Define the sections, and where they are mapped in memory */

SECTIONS
{
.vectors.reset 0x0 : {
   KEEP (*(.vectors.reset))
} 

.vectors.sw_exception 0x8 : {
   KEEP (*(.vectors.sw_exception))
} 

.vectors.interrupt 0x10 : {
   KEEP (*(.vectors.interrupt))
} 

.vectors.hw_exception 0x20 : {
   KEEP (*(.vectors.hw_exception))
} 

.text : {
   *(.text)
   *(.text.*)
   *(.gnu.linkonce.t.*)
} > microblaze_0_local_memory_ilmb_bram_if_cntlr_Mem_microblaze_0_local_memory_dlmb_bram_if_cntlr_Mem

.init : {
   KEEP (*(.init))
} > microblaze_0_local_memory_ilmb_bram_if_cntlr_Mem_microblaze_0_local_memory_dlmb_bram_if_cntlr_Mem

.fini : {
   KEEP (*(.fini))
} > microblaze_0_local_memory_ilmb_bram_if_cntlr_Mem_microblaze_0_local_memory_dlmb_bram_if_cntlr_Mem

.ctors : {
   __CTOR_LIST__ = .;
   ___CTORS_LIST___ = .;
   KEEP (*crtbegin.o(.ctors))
   KEEP (*(EXCLUDE_FILE(*crtend.o) .ctors))
   KEEP (*(SORT(.ctors.*)))
   KEEP (*(.ctors))
   __CTOR_END__ = .;
   ___CTORS_END___ = .;
} > microblaze_0_local_memory_ilmb_bram_if_cntlr_Mem_microblaze_0_local_memory_dlmb_bram_if_cntlr_Mem

.dtors : {
   __DTOR_LIST__ = .;
   ___DTORS_LIST___ = .;
   KEEP (*crtbegin.o(.dtors))
   KEEP (*(EXCLUDE_FILE(*crtend.o) .dtors))
   KEEP (*(SORT(.dtors.*)))
   KEEP (*(.dtors))
   PROVIDE(__DTOR_END__ = .);
   PROVIDE(___DTORS_END___ = .);
} > microblaze_0_local_memory_ilmb_bram_if_cntlr_Mem_microblaze_0_local_memory_dlmb_bram_if_cntlr_Mem

.rodata : {
   __rodata_start = .;
   *(.rodata)
   *(.rodata.*)
   *(.gnu.linkonce.r.*)
   __rodata_end = .;
} > microblaze_0_local_memory_ilmb_bram_if_cntlr_Mem_microblaze_0_local_memory_dlmb_bram_if_cntlr_Mem

.sdata2 : {
   . = ALIGN(8);
   __sdata2_start = .;
   *(.sdata2)
   *(.sdata2.*)
   *(.gnu.linkonce.s2.*)
   . = ALIGN(8);
   __sdata2_end = .;
} > microblaze_0_local_memory_ilmb_bram_if_cntlr_Mem_microblaze_0_local_memory_dlmb_bram_if_cntlr_Mem

.sbss2 : {
   __sbss2_start = .;
   *(.sbss2)
   *(.sbss2.*)
   *(.gnu.linkonce.sb2.*)
   __sbss2_end = .;
} > microblaze_0_local_memory_ilmb_bram_if_cntlr_Mem_microblaze_0_local_memory_dlmb_bram_if_cntlr_Mem

.data : {
   . = ALIGN(4);
   __data_start = .;
   *(.data)
   *(.data.*)
   *(.gnu.linkonce.d.*)
   __data_end = .;
} > microblaze_0_local_memory_ilmb_bram_if_cntlr_Mem_microblaze_0_local_memory_dlmb_bram_if_cntlr_Mem

.got : {
   *(.got)
} > microblaze_0_local_memory_ilmb_bram_if_cntlr_Mem_microblaze_0_local_memory_dlmb_bram_if_cntlr_Mem

.got1 : {
   *(.got1)
} > microblaze_0_local_memory_ilmb_bram_if_cntlr_Mem_microblaze_0_local_memory_dlmb_bram_if_cntlr_Mem

.got2 : {
   *(.got2)
} > microblaze_0_local_memory_ilmb_bram_if_cntlr_Mem_microblaze_0_local_memory_dlmb_bram_if_cntlr_Mem

.eh_frame : {
   *(.eh_frame)
} > microblaze_0_local_memory_ilmb_bram_if_cntlr_Mem_microblaze_0_local_memory_dlmb_bram_if_cntlr_Mem

.jcr : {
   *(.jcr)
} > microblaze_0_local_memory_ilmb_bram_if_cntlr_Mem_microblaze_0_local_memory_dlmb_bram_if_cntlr_Mem

.gcc_except_table : {
   *(.gcc_except_table)
} > microblaze_0_local_memory_ilmb_bram_if_cntlr_Mem_microblaze_0_local_memory_dlmb_bram_if_cntlr_Mem

.sdata : {
   . = ALIGN(8);
   __sdata_start = .;
   *(.sdata)
   *(.sdata.*)
   *(.gnu.linkonce.s.*)
   __sdata_end = .;
} > microblaze_0_local_memory_ilmb_bram_if_cntlr_Mem_microblaze_0_local_memory_dlmb_bram_if_cntlr_Mem

.sbss (NOLOAD) : {
   . = ALIGN(4);
   __sbss_start = .;
   *(.sbss)
   *(.sbss.*)
   *(.gnu.linkonce.sb.*)
   . = ALIGN(8);
   __sbss_end = .;
} > microblaze_0_local_memory_ilmb_bram_if_cntlr_Mem_microblaze_0_local_memory_dlmb_bram_if_cntlr_Mem

.tdata : {
   __tdata_start = .;
   *(.tdata)
   *(.tdata.*)
   *(.gnu.linkonce.td.*)
   __tdata_end = .;
} > microblaze_0_local_memory_ilmb_bram_if_cntlr_Mem_microblaze_0_local_memory_dlmb_bram_if_cntlr_Mem

.tbss : {
   __tbss_start = .;
   *(.tbss)
   *(.tbss.*)
   *(.gnu.linkonce.tb.*)
   __tbss_end = .;
} > microblaze_0_local_memory_ilmb_bram_if_cntlr_Mem_microblaze_0_local_memory_dlmb_bram_if_cntlr_Mem

.bss (NOLOAD) : {
   . = ALIGN(4);
   __bss_start = .;
   *(.bss)
   *(.bss.*)
   *(.gnu.linkonce.b.*)
   *(COMMON)
   . = ALIGN(4);
   __bss_end = .;
} > microblaze_0_local_memory_ilmb_bram_if_cntlr_Mem_microblaze_0_local_memory_dlmb_bram_if_cntlr_Mem

_SDA_BASE_ = __sdata_start + ((__sbss_end - __sdata_start) / 2 );

_SDA2_BASE_ = __sdata2_start + ((__sbss2_end - __sdata2_start) / 2 );

/* Generate Stack and Heap definitions */

.heap (NOLOAD) : {
   . = ALIGN(8);
   _heap = .;
   _heap_start = .;
   . += _HEAP_SIZE;
   _heap_end = .;
} > microblaze_0_local_memory_ilmb_bram_if_cntlr_Mem_microblaze_0_local_memory_dlmb_bram_if_cntlr_Mem

.stack (NOLOAD) : {
   _stack_end = .;
   . += _STACK_SIZE;
   . = ALIGN(8);
   _stack = .;
   __stack = _stack;
} > microblaze_0_local_memory_ilmb_bram_if_cntlr_Mem_microblaze_0_local_memory_dlmb_bram_if_cntlr_Mem

_end = .;
}

